## components/balancer/Kconfig
```kconfig
menu "Bala2 balancer"

    config BALANCER_LOOP_HZ
        int "Control loop rate (Hz)"
        default 200
        range 50 400

    config BALANCER_PWM_LIMIT
        int "Max motor PWM (abs, 0..1023)"
        default 400
        range 50 1023
        help
            Conservative default. Raise as you tune. Reference
            implementation uses 1023.

    config BALANCER_TILT_CUTOFF_DEG
        int "Safety cutoff tilt (deg)"
        default 45
        range 20 75
        help
            If |angle| exceeds this, motors are disarmed and the
            balancer enters CRASHED until manually re-armed.

    config BALANCER_ARM_ANGLE_DEG
        int "Arming window (deg)"
        default 10
        range 1 30
        help
            To arm, the robot must be within +/- this many degrees of
            the setpoint and moving slowly for BALANCER_ARM_STILL_MS.

    config BALANCER_ARM_STILL_MS
        int "Arming still time (ms)"
        default 300
        range 50 2000

    config BALANCER_SETPOINT_MDEG
        int "Target tilt setpoint (millideg)"
        default 0
        range -5000 5000
        help
            Balance target in 1/1000 deg. Tune per-robot for weight
            balance; reference uses ~-1500 (-1.5 deg).

    comment "Angle PID  (outer loop on tilt, output = PWM)"

    config BALANCER_ANGLE_KP_MILLI
        int "Angle kp (x1000)"
        default 15000
        help
            Reference is 24000. Conservative default is lower.

    config BALANCER_ANGLE_KI_MILLI
        int "Angle ki (x1000)"
        default 0

    config BALANCER_ANGLE_KD_MILLI
        int "Angle kd (x1000)"
        default 60000
        help
            Reference is 90000.

    config BALANCER_ANGLE_DIR_POS
        bool "Angle PID output positive direction"
        default n
        help
            If the robot drives INTO the fall instead of away from it,
            toggle this. Equivalent to multiplying kp/ki/kd by -1.

    comment "Speed PID  (inner loop on wheel speed, output adds to PWM)"

    config BALANCER_SPEED_KP_MILLI
        int "Speed kp (x1000)"
        default 15000

    config BALANCER_SPEED_KI_MILLI
        int "Speed ki (x1000)"
        default 75

    config BALANCER_SPEED_KD_MILLI
        int "Speed kd (x1000)"
        default 0

    config BALANCER_SPEED_I_LIMIT
        int "Speed PID integral clamp"
        default 40

    config BALANCER_SPEED_DIR_POS
        bool "Speed PID output positive direction"
        default y

    comment "Sensor axis / motor polarity"

    choice BALANCER_TILT_ACCEL_AXIS
        prompt "Accelerometer tilt axis"
        default BALANCER_TILT_ACCEL_AXIS_Y
        config BALANCER_TILT_ACCEL_AXIS_X
            bool "X"
        config BALANCER_TILT_ACCEL_AXIS_Y
            bool "Y"
        config BALANCER_TILT_ACCEL_AXIS_Z
            bool "Z"
    endchoice

    config BALANCER_TILT_ACCEL_INVERT
        bool "Invert accelerometer tilt sign"
        default n

    choice BALANCER_TILT_GYRO_AXIS
        prompt "Gyro rate axis"
        default BALANCER_TILT_GYRO_AXIS_X
        config BALANCER_TILT_GYRO_AXIS_X
            bool "X"
        config BALANCER_TILT_GYRO_AXIS_Y
            bool "Y"
        config BALANCER_TILT_GYRO_AXIS_Z
            bool "Z"
    endchoice

    config BALANCER_TILT_GYRO_INVERT
        bool "Invert gyro rate sign"
        default n

    config BALANCER_MOTOR_INVERT_LEFT
        bool "Invert LEFT motor"
        default n

    config BALANCER_MOTOR_INVERT_RIGHT
        bool "Invert RIGHT motor"
        default n

endmenu
```

## main/Kconfig.projbuild
```kconfig
menu "Bala2 Fire configuration"

    config BALA2_WIFI_SSID
        string "Wi-Fi SSID"
        default ""
        help
            SSID of the Wi-Fi network the Bala2 Fire should join.
            Leave blank to skip Wi-Fi on boot (the display will show
            "Wi-Fi: not configured").

    config BALA2_WIFI_PASSWORD
        string "Wi-Fi password"
        default ""
        help
            WPA/WPA2 password. Leave blank for an open network.

    config BALA2_WIFI_CONNECT_TIMEOUT_MS
        int "Wi-Fi connect timeout (ms)"
        default 10000
        range 1000 60000
        help
            How long to wait for an IP before giving up and showing
            "Wi-Fi: failed" on the display.

endmenu
```

## sdkconfig.defaults
```kconfig
# M5Stack Fire / Bala2 Fire defaults
CONFIG_IDF_TARGET="esp32"

# 16 MB flash
CONFIG_ESPTOOLPY_FLASHSIZE_16MB=y
CONFIG_ESPTOOLPY_FLASHSIZE="16MB"

# 4 MB PSRAM
CONFIG_SPIRAM=y
CONFIG_SPIRAM_MODE_QUAD=y
CONFIG_SPIRAM_TYPE_AUTO=y
CONFIG_SPIRAM_SPEED_80M=y
CONFIG_SPIRAM_USE_MALLOC=y

# Higher CPU clock for balancing loop
CONFIG_ESP_DEFAULT_CPU_FREQ_MHZ_240=y
CONFIG_ESP_DEFAULT_CPU_FREQ_MHZ=240

# C++ exceptions off (M5Unified uses RTTI but not exceptions)
CONFIG_COMPILER_CXX_RTTI=y

# 1 kHz FreeRTOS tick so the 200 Hz balancer loop has 5 ms resolution.
# (Default is 100 Hz, which rounds pdMS_TO_TICKS(5) to 0 ticks.)
CONFIG_FREERTOS_HZ=1000

# Angle PID direction: tested on-hardware. The default direction had
# wheels driving INTO the fall; flipping to POS=y was previously logged
# as the fix, but on the current bot the wheels still spin backward
# during balance. Flip back to negative direction.
# CONFIG_BALANCER_ANGLE_DIR_POS is not set

# Bumped balance gains toward the reference impl. Verified on hardware:
# at kp=24 / kd=90 / PWM=400 the bot ran away from disturbances. At
# kp=24 / kd=180 / PWM=800 / setpoint=+1.0 the bot achieves stable
# balance (steady angle near 0 with PWM ~ ±40, no constant forward
# drive) but still can't reject disturbances >= ~6° before the fall
# becomes irrecoverable. Bumping PWM_LIMIT to the hardware max (1023)
# gives the angle PID full recovery authority during transients;
# steady-state is unaffected (steady PWM was ±40 << 1023).
CONFIG_BALANCER_PWM_LIMIT=1023
CONFIG_BALANCER_ANGLE_KP_MILLI=24000
CONFIG_BALANCER_ANGLE_KD_MILLI=180000

# Setpoint trim: this physical bot's "natural upright" sits at IMU
# angle ~+1.0° (observed during multiple stable-balance windows of
# 2-17 s: angle hovered at +0.9..+1.3° with steady PWM near +30
# driving the bot forward against the floor at setpoint=0). With
# setpoint=+1.0 the controller no longer drives forward in steady
# state; PWM hovers around 0 and the bot holds station.
#
# Reference impl uses -1.5° (their bot's calibrated angle_center).
# Same role, different per-bot value.
CONFIG_BALANCER_SETPOINT_MDEG=1000

# Speed PID direction: matches the M5Stack Bala2 reference impl
# (https://github.com/m5stack/M5-ProductExampleCodes/tree/master/Application/Bala2)
# which uses speed_pid.SetDirection(1). Earlier guess that this bot's
# encoder polarity required a flip turned out to be wrong — reverting.
CONFIG_BALANCER_SPEED_DIR_POS=y

# OTA partition layout (two ~3 MB app slots + 10 MB FAT) so we can flash
# new firmware over Wi-Fi via components/bala2_ota.
CONFIG_PARTITION_TABLE_CUSTOM=y
CONFIG_PARTITION_TABLE_CUSTOM_FILENAME="partitions.csv"
CONFIG_PARTITION_TABLE_FILENAME="partitions.csv"

# Enable rollback so a broken OTA reboots into the previous slot.
CONFIG_BOOTLOADER_APP_ROLLBACK_ENABLE=y

# OTA streams a ~1 MB POST body; allow generous HTTP recv timeouts and
# a slightly bigger HTTP server stack.
CONFIG_HTTPD_MAX_REQ_HDR_LEN=1024
CONFIG_HTTPD_MAX_URI_LEN=512
```
